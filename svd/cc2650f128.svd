# CC2650F128 register map
File version: 1.0
SimpleLink(TM) multi-protocol CC2650 wireless MCU for 2.4 GHz applications
CPU: Cortex_M3 1.0, other endian, MPU, FPU, 3 interrupt priority bits
Registers are 32-bit, read-write, reset 0x0 unless marked. A register's access mark holds for its fields unless they carry their own. Offsets are from the block's base; lines under a group give offsets from that group; [hi:lo] are bit positions; {n}, {i} and the like mark numbered series; 'fields as' and 'values as' point back to an identical list; <NAME> marks a mode.

## Memory map
0x00000000 _INTERRUPTS
0x40000000 SSI0 size 0x1000 — Synchronous Serial Interface with master and slave capabilities
0x40001000 UART0 size 0x1000 — Universal Asynchronous Receiver/Transmitter (UART) interface
0x40002000 I2C0 size 0x1000 — I2CMaster/Slave Serial Controler
0x40008000 SSI1 size 0x1000 — Synchronous Serial Interface with master and slave capabilities
0x40010000 GPT0 size 0x1000 — General Purpose Timer.
0x40011000 GPT1 size 0x1000 — General Purpose Timer.
0x40012000 GPT2 size 0x1000 — General Purpose Timer.
0x40013000 GPT3 size 0x1000 — General Purpose Timer.
0x40020000 UDMA0 size 0x1000 — ARM Micro Direct Memory Access Controller
0x40021000 I2S0 size 0x1000 — I2S Audio DMA module supporting formats I2S, LJF, RJF and DSP
0x40022000 GPIO size 0x400 — MCU GPIO - I/F for controlling and reading IO status and IO event status
0x40024000 CRYPTO size 0x800 — Crypto core with DMA capability and local key storage
0x40028000 TRNG size 0x2000 — True Random Number Generator
0x40030000 FLASH size 0x4000 — Flash sub-system registers, includes the Flash Memory Controller (FMC), flash read path, and an integrated Efuse controller and EFUSEROM.
0x40034000 VIMS size 0x400 — Versatile Instruction Memory System Controls memory access to the Flash and encapsulates the following instruction memories: - Boot ROM - Cache / GPRAM
0x40040000 RFC_PWR size 0x4 — RF Core Power Management
0x40041000 RFC_DBELL size 0x40 — RF Core Doorbell
0x40043000 RFC_RAT size 0x100 — RF Core Radio Timer
0x40080000 WDT size 0x1000 — Watchdog Timer
0x40081000 IOC size 0x1000 — IO Controller (IOC) - configures all the DIOs and resides in the MCU domain.
0x40082000 PRCM size 0x1000 — Power, Reset and Clock Management
0x40083000 EVENT size 0x1000 — Event Fabric Component Definition
0x40084000 SMPH size 0x1000 — MCU Semaphore Module This module provides 32 binary semaphores. The state of a binary semaphore is either taken or available. A semaphore does not implement any ownership attribute. Still, a semaphore can be used to handle mutual exclusion scenarios.
0x40090000 AON_SYSCTL size 0x400 — This component controls AON_SYSCTL, which is the device's system controller. Note: This module is only supporting 32 bit ReadWrite access from MCU
0x40091000 AON_WUC size 0x1000 — This component control the Wakeup controller residing in the AON domain. Note: This module is only supporting 32 bit ReadWrite access from MCU
0x40092000 AON_RTC size 0x400 — This component control the Real Time Clock residing in AON Note: This module is only supporting 32 bit ReadWrite access.
0x40093000 AON_EVENT size 0x400 — This module configures the event fabric located in the AON domain. Note: This module is only supporting 32 bit ReadWrite access from MCU
0x40094000 AON_IOC size 0x400 — Always On (AON) IO Controller - controls IO operation when the MCU IO Controller (IOC) is powered off and resides in the AON domain. Note: This module only supports 32 bit Read/Write access from MCU.
0x40095000 AON_BATMON size 0x400 — Always On (AON) Battery And Temperature MONitor (BATMON) residing in the AON domain Note: This module only supports 32 bit Read/Write access from MCU.
0x400C1000 AUX_AIODIO0 size 0x1000 — AUX Analog/Digital Input Output Controller
0x400C2000 AUX_AIODIO1 size 0x1000 — AUX Analog/Digital Input Output Controller
0x400C4000 AUX_TDCIF size 0x1000 — AUX Time To Digital Converter
0x400C5000 AUX_EVCTL size 0x1000 — AUX Event Controller
0x400C6000 AUX_WUC size 0x1000 — AUX Wake-up controller
0x400C7000 AUX_TIMER size 0x1000
0x400C8000 AUX_SMPH size 0x1000 — AUX Semaphore Controller
0x400C9000 AUX_ANAIF size 0x1000 — AUX Analog Peripheral Control Module
0x400CA000 AUX_DDI0_OSC size 0x1000 — This is the DDI for the digital block that controls all the analog clock oscillators (OSC_DIG) and performs qualification of the clocks generated.
0x400CB000 AUX_ADI4 size 0x200 — Configuration registers controlling analog peripherals of AUX. Registers Fields should be considered static unless otherwise noted (as dynamic)
0x400E1000 AUX_SCE size 0x1000 — AUX Sensor Control Engine Control Module
0x50001000 FCFG1 size 0x400 — Factory configuration area (FCFG1)
0x50003000 CCFG size 0x1000 — Customer configuration area (CCFG)
0xE0000000 CPU_ITM size 0x1000 — Cortex-M's Instrumentation Trace Macrocell (ITM)
0xE0001000 CPU_DWT size 0x1000 — Cortex-M's Data watchpoint and Trace (DWT)
0xE0002000 CPU_FPB size 0x1000 — Cortex-M's Flash Patch and Breakpoint (FPB)
0xE000E000 CPU_SCS size 0x1000 — Cortex-M's System Control Space (SCS)
0xE0040000 CPU_TPIU size 0x1000 — Cortex-M3's Trace Port Interface Unit (TPIU)
0xE00FE000 CPU_TIPROP size 0x1000 — Cortex-M's TI proprietary registers

## Interrupts
0 GPIO (_INTERRUPTS) — GPIO edge detect
1 I2C (_INTERRUPTS)
2 RFC_PE0 (_INTERRUPTS) — RF Core and packet engine 1
4 AON_RTC (_INTERRUPTS)
5 UART0 (_INTERRUPTS)
6 AUX_SWEV0 (_INTERRUPTS) — AUX software event 0
7 SSI0 (_INTERRUPTS)
8 SSI1 (_INTERRUPTS)
9 RFC_PE1 (_INTERRUPTS) — RF Core and packet engine 2
10 RFC (_INTERRUPTS) — RF Core hardware
11 RFC_CA (_INTERRUPTS) — RF command acknowledge
12 I2S (_INTERRUPTS)
13 AUX_SWEV1 (_INTERRUPTS) — AUX software event 1
14 WDT (_INTERRUPTS) — Watchdog timer
15 GPT0A (_INTERRUPTS) — GPTimer 0A
16 GPT0B (_INTERRUPTS) — GPTimer 0B
17 GPT1A (_INTERRUPTS) — GPTimer 1A
18 GPT1B (_INTERRUPTS) — GPTimer 1B
19 GPT2A (_INTERRUPTS) — GPTimer 2A
20 GPT2B (_INTERRUPTS) — GPTimer 2B
21 GPT3A (_INTERRUPTS) — GPTimer 3A
22 GPT3B (_INTERRUPTS) — GPTimer 3B
23 CRYPTO (_INTERRUPTS)
24 UDMA (_INTERRUPTS) — μDMA software defined
25 UDMA_ERR (_INTERRUPTS) — μDMA error
26 FLASH (_INTERRUPTS)
27 SWE0 (_INTERRUPTS) — Software event 0
28 AUX_CE (_INTERRUPTS) — AUX combined event
29 AON_EVENT (_INTERRUPTS) — AON programmable event
30 DYN_EVENT (_INTERRUPTS) — Dynamic programmable event
31 AUX_COMPA (_INTERRUPTS) — AUX comparator A
32 AUX_MISC (_INTERRUPTS) — AUX ADC new sample available or ADC DMA done, ADC underflow and overflow
33 TRNG (_INTERRUPTS) — True random number generator
